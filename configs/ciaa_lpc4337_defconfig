## configs/ciaa_lpc4337_defconfig
```kconfig
BR2_arm=y
BR2_cortex_m3=y
BR2_ARM_INSTRUCTIONS_THUMB2=y
BR2_PREFER_STATIC_LIB=y
BR2_TOOLCHAIN_EXTERNAL=y
BR2_ENABLE_LOCALE_PURGE=y
BR2_ENABLE_LOCALE_WHITELIST="C"
BR2_TARGET_GENERIC_HOSTNAME="ciaa-nxp"
BR2_TARGET_GENERIC_ISSUE="Computadora Industrial Abierta Argentina"
BR2_TARGET_GENERIC_PASSWD_DES=y
BR2_INIT_NONE=y
# BR2_TARGET_GENERIC_GETTY is not set
BR2_ROOTFS_OVERLAY="board/ciaa/lpc4337/overlay"
BR2_LINUX_KERNEL=y
BR2_LINUX_KERNEL_CUSTOM_GIT=y
BR2_LINUX_KERNEL_CUSTOM_REPO_URL="https://github.com/ciaa/linux.git"
BR2_LINUX_KERNEL_CUSTOM_REPO_VERSION="master"
BR2_LINUX_KERNEL_DEFCONFIG="ciaa_lpc4337"
BR2_LINUX_KERNEL_APPENDED_UIMAGE=y
BR2_LINUX_KERNEL_UIMAGE_LOADADDR="0x28008000"
BR2_LINUX_KERNEL_INTREE_DTS_NAME="lpc4337-ciaa"
BR2_PACKAGE_BUSYBOX_CONFIG="board/ciaa/lpc4337/busybox/busybox.config"
BR2_PACKAGE_STRACE=y
BR2_PACKAGE_I2C_TOOLS=y
BR2_PACKAGE_MEMTESTER=y
BR2_PACKAGE_MII_DIAG=y
BR2_TARGET_ROOTFS_INITRAMFS=y
# BR2_TARGET_ROOTFS_TAR is not set
BR2_TARGET_UBOOT=y
BR2_TARGET_UBOOT_BOARDNAME="ciaa_lpc4337"
BR2_TARGET_UBOOT_CUSTOM_GIT=y
BR2_TARGET_UBOOT_CUSTOM_REPO_URL="https://github.com/ciaa/u-boot.git"
BR2_TARGET_UBOOT_CUSTOM_REPO_VERSION="master"
BR2_PACKAGE_HOST_OPENOCD=y
```
